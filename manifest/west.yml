## manifest/west.yml
```yaml
manifest:
  version: "0.13"

  remotes:
    - name: nrf
      url-base: https://github.com/nrfconnect

  projects:
    - name: nrf
      remote: nrf
      repo-path: sdk-nrf
      revision: v3.1.1
      import:
        name-allowlist:
          - cmsis_6
          - hal_nordic
          - mbedtls
          - mcuboot
          - nrfxlib
          - oberon-psa-crypto
          - zephyr
  self:
    path: manifest
```

## west.yml
```yaml
# The west manifest file (west.yml) for the Zephyr OS environment
#
# See the west documentation for more information:
# https://docs.zephyrproject.org/latest/develop/west/index.html

manifest:
  # This west.yml requires west 0.12s or later, because the "import"
  # feature used below was introduced then.
  version: 0.12

  projects:
    - name: zepyhr
      url: https://github.com/zephyrproject-rtos/zephyr
      import: true

  self:
    path: .
```
